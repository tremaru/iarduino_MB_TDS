// ПРИМЕР КАЛИБРОВКИ МОДУЛЯ БЕЗ КНОПКИ:                                            //
                                                                                   //
#include <iarduino_Modbus.h>                                                       //   Подключаем библиотеку для работы по протоколу Modbus.
#include <iarduino_MB_TDS.h>                                                       //   Подключаем библиотеку для работы с TDS-метрами.
                                                                                   //
ModbusClient    modbus(Serial1, 2);                                                //   Создаём объект для работы по протоколу Modbus указывая объект шины UART-RS485 и вывод DE конвертера UART-RS485.
iarduino_MB_TDS sensor(modbus);                                                    //   Создаём объект для работы с TDS-метром указывая объект протокола Modbus.
                                                                                   //
void setup(){                                                                      //
     int8_t f;                                                                     //
     Serial.begin(9600); while(!Serial);                                           //   Инициируем передачу данных в монитор последовательного порта, указав его скорость.
     Serial1.begin(9600); while(!Serial1);                                         //   Инициируем работу с шиной UART-RS485 указав её скорость.
     modbus.begin();                                                               //   Инициируем работу по протоколу Modbus.
//   modbus.setTimeout(10);                                                        //   Указываем максимальное время ожидания ответа по протоколу Modbus.
//   modbus.setDelay(4);                                                           //   Указываем минимальный интервал между отправляемыми сообщениями по протоколу Modbus.
//   modbus.setTypeMB( MODBUS_RTU );                                               //   Указываем тип протокола Modbus: MODBUS_RTU (по умолчанию), или MODBUS_ASCII.
     f = sensor.begin(5);                                                          //   Инициируем работу с TDS-метром, указав его адрес. Если адрес не указан f = sensor.begin(), то он будет найден, но это займёт некоторое время.
//   sensor.setKt(0.02f);                                                          //   Указываем температурный коэффициент жидкости. Значение зависит от типа раствора. Используется для приведения S к EC. По умолчанию 0.02 = 2%.
//   sensor.setKp(0.5f);                                                           //   Указываем коэффициент пересчёта EC в TDS. Значение зависит от химического состава жидкости. Обычно применяют 0.5, 0.64 или 0.7. По умолчанию 0.5.
//   sensor.set_T(25);                                                             //   Указываем опорную температуру жидкости. Обычно используют 20°С или 25°С. По умолчанию 25°С.
                                                                                   //
//   Если любая из стадий калибровки длится дольше 1 минуты:                       //
//   sensor.setFluctuation(   STABLE_S, 1.0f );                                    //   Указваем процент допустимой флуктуации, при которой показания считаются стабильными. По умолчанию 0,5 %.
//   sensor.setFluctuation( UNSTABLE_S, 2.0f );                                    //   Указваем процент высокой флуктуации, при которой показания считаются нестабильными. По умолчанию 1,0 %.
                                                                                   //   Сбросить значения в заводские поможет пример setSettings.
//   Выводим подсказки в монитор последовательного порта:                          //
     if( !f ){ Serial.println(F("Модуль не отвечает.")); return; }                 //
     Serial.println(F("Для калибровки потребуется две калибровочные жидкости:"));  //
     Serial.print  (F("- первая с минерализацией "));                              //
     Serial.print  (sensor.getKnownTDS(1) );                                       //   Выводим количество растворённых твёрдых веществ первой калибровочной жидкости.
     Serial.print  (F(" ppm = "));                                                 //
     Serial.print  (sensor.getKnownEC(1) );                                        //   Выводим приведённую электропроводность первой калибровочной жидкости.
     Serial.println(F(" мСм/см."));                                                //
     Serial.print  (F("- вторая с минерализацией "));                              //
     Serial.print  (sensor.getKnownTDS(2) );                                       //   Выводим количество растворённых твёрдых веществ второй калибровочной жидкости.
     Serial.print  (F(" ppm = "));                                                 //
     Serial.print  (sensor.getKnownEC(2) );                                        //   Выводим приведённую электропроводность второй калибровочной жидкости.
     Serial.println(F(" мСм/см."));                                                //
     Serial.println();                                                             //
     Serial.println(F("Опустите датчик в первую калибровочную жидкость и"));       //
     Serial.println(F("введите любой символ в монитор последовательного порта.")); //
     Serial.println();                                                             //
//   Указываем температуру калибровочных жидкостей:                                //
     sensor.set_t(25.0);                                                           //   Температура обеих калибровочных жидкостей должна быть одинаковая.
//   Ждём ввода любого символа в монитор последовательного порта:                  //
     while( !Serial.available() );                                                 //   Выполняем цикл пока не получим данные из монитора последовательного порта.
//   Начинаем калибровку:                                                          //
     f = sensor.setCalibration();                                                  //   Запускаем калибровку.
     if( f ){ Serial.println(F("Калибровка запущена."));         }                 //
     else   { Serial.println(F("Модуль не отвечает." )); return; }                 //
//   Сообщаем о выполнении 1 стадии калибровки:                                    //
     if( sensor.getCalibration()==1 ){                                             //
         Serial.println(F("Выполняется первая стадия калибровки..."));             //
         do{ f=sensor.getCalibration(); delay(100); }while( f==1 || f<0 );         //   Ждём завершения 1 стадии калибровки...
         Serial.println(F("Первая стадия калибровки завершена."));                 //
     }                                                                             //
//   Информируем о необходимости смены калибровочной жидкости:                     //
     if( sensor.getCalibration()==3 ){                                             //
         Serial.println();                                                         //
         Serial.println(F("Извлеките датчик из первой калибровочной жидкости."));  //
         Serial.println(F("Ополосните датчик в дистиллированной воде."));          //
         Serial.println(F("Опустите датчик во вторую калибровочную жидкость."));   //
         do{ f=sensor.getCalibration(); delay(100); }while( f==3 || f<0 );         //   Ждём когда модуль зафиксирует изменение проводимости...
     }                                                                             //
//   Сообщаем о выполнении 2 стадии калибровки:                                    //
     if( sensor.getCalibration()==2 ){                                             //
         Serial.println();                                                         //
         Serial.println(F("Выполняется вторая стадия калибровки..."));             //
         do{ f=sensor.getCalibration(); delay(100); }while( f==2 || f<0 );         //   Ждём завершения 2 стадии калибровки...
         Serial.println(F("Вторая стадия калибровки завершена."));                 //
     }                                                                             //
//   Сообщаем о ошибке калибровки:                                                 //
     if( sensor.getResultCalib()==false ){                                         //
         Serial.println();                                                         //
         Serial.println(F("Калибровка не выполнена. Данные не сохранены." ));      //
         Serial.println(F("Если любая из стадий калибровки длилась дольше 1мин,"));//
         Serial.println(F("то стоит увеличить диапазон флуктуаций."));             //
         Serial.println(F("См. комментарии скетча с функцией setFluctuation().")); //
         Serial.print  (F("Сейчас диапазон флуктуаций задан значениями: " ));      //   На 1 и 2 стадиях калибровки модуль ждёт стабилизации показаний электропроводности.
         Serial.print  ( sensor.getFluctuation(STABLE_S), 1 );                     //   Показания считаются стабильными если среднее значение электропроводности за последние 10 секунд не сместилось за процент допустимой флуктуации.
         Serial.print  (F(" ... "));                                               //   Если показания стали нестабильными, модуль заново начнёт ждать их стабилизации.
         Serial.print  ( sensor.getFluctuation(UNSTABLE_S), 1 );                   //   Показания считаются не стабильными если среднее значение электропроводности за последние 10 секунд сместилось за процент высокой флуктуации.
         Serial.println(F(" %."));                                                 //
         return;                                                                   //
     }                                                                             //
//   Сообщаем о успехе калибровки и выводим данные полученные в её процессе:       //
     float ka = sensor.getKa();                                                    //   Получаем рассчитанный множитель степенной функции (0,001...4'294'967,295).
     float kb = sensor.getKb();                                                    //   Получаем рассчитанный модуль степени степенной функции (0,001...65,535).
     Serial.println();                                                             //
     Serial.println(F("Калибровка успешно завершена. Данные сохранены." ));        //
     Serial.println(F("Результат калибровки:"));                                   //
     Serial.print  (F("Определён множитель Ka = ")); Serial.println(ka,3);         //
     Serial.print  (F("Определена степень Kb =-"));  Serial.println(kb,2);         //
     Serial.println(F("Новые значения сохранены в энергонезависимую память."));    //
     Serial.println();                                                             //
     Serial.println(F("Дальнейшие вычисления модуль будет производить"));          //
     Serial.print  (F("по формуле: Злектропроводность S = Ka * Vout^Kb = "));      //
     Serial.print  (ka,3); Serial.print(F(" * Vout^(-")); Serial.print(kb,2);      //
     Serial.println(F(") мкСм/см."));                                              //
}                                                                                  //
                                                                                   //
void loop(){                                                                       //
}                                                                                  //