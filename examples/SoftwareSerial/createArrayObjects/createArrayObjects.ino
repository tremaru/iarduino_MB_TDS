// ПРИМЕР УПРАВЛЕНИЯ ВСЕМИ TDS-МЕТРАМИ НА ШИНЕ:                                    //
// без указания их адресов в скетче.                                               //
                                                                                   //
#include <SoftwareSerial.h>                                                        //   Подключаем библиотеку для работы с программной шиной UART.
#include <iarduino_Modbus.h>                                                       //   Подключаем библиотеку для работы по протоколу Modbus.
#include <iarduino_MB_TDS.h>                                                       //   Подключаем библиотеку для работы с TDS-метрами.
                                                                                   //
SoftwareSerial   rs485(8,9);                                                       //   Создаём объект для работы с программной шиной UART-RS485 указывая выводы RX, TX.
ModbusClient     modbus(rs485, 2);                                                 //   Создаём объект для работы по протоколу Modbus указывая объект программной шины UART-RS485 и вывод DE конвертера UART-RS485.
iarduino_MB_TDS* sensor;                                                           //   Создаём указатель который будет переопределён в массив объектов работы с TDS-метрами.
                                                                                   //
uint8_t sum=0;                                                                     //   Определяем переменную для хранения количества найденных TDS-метров.
                                                                                   //
void setup(){                                                                      //
     Serial.begin(9600); while(!Serial);                                           //   Инициируем передачу данных в монитор последовательного порта, указав его скорость.
     rs485.begin(9600); while(!rs485);                                             //   Инициируем работу с программной шиной UART-RS485 указав её скорость.
     modbus.begin();                                                               //   Инициируем работу по протоколу Modbus.
//   modbus.setTimeout(10);                                                        //   Указываем максимальное время ожидания ответа по протоколу Modbus.
//   modbus.setDelay(4);                                                           //   Указываем минимальный интервал между отправляемыми сообщениями по протоколу Modbus.
//   modbus.setTypeMB( MODBUS_RTU );                                               //   Указываем тип протокола Modbus: MODBUS_RTU (по умолчанию), или MODBUS_ASCII.
//   Выполняем поиск всех TDS-метров на шине (занимает несколько секунд):          //
     Serial.println("Поиск TDS-метров ..." );                                      //
     sum = modbus.findID( DEF_MODEL_TDS );                                         //   Ищем адреса всех устройств с идентификатором TDS-метра DEF_MODEL_TDS.
     uint8_t arrID[sum], num=0;                                                    //   Объявляем массив arrID для хранения найденных адресов.
     while( modbus.available() ){ arrID[num++]=modbus.read(); }                    //   Заполняем массив arrID найденными адресами.
     if( sum ){                                                                    //
     //  Переопределяем указатель sensor в массив объектов:                        //
         sensor = (iarduino_MB_TDS*) malloc( sizeof(iarduino_MB_TDS)*sum );        //   Выделяем под массив sensor требуемый объем памяти.
     //  Инициируем работу с TDS-метрами:                                          //
         for(uint8_t i=0; i<sum; i++){                                             //
             sensor[i]=modbus;                                                     //   Указываем очередному объекту работы с TDS-метром, объект протокола Modbus.
             sensor[i].begin( arrID[i] );                                          //   Инициируем работу с очередным TDS-метром, указав очередной адрес из ранее найденных.
         //  sensor.setKt(0.02f);                                                  //   Указываем температурный коэффициент жидкости. Значение зависит от типа раствора. Используется для приведения S к EC. По умолчанию 0.02 = 2%.
         //  sensor.setKp(0.5f);                                                   //   Указываем коэффициент пересчёта EC в TDS. Значение зависит от химического состава жидкости. Обычно применяют 0.5, 0.64 или 0.7. По умолчанию 0.5.
         //  sensor.set_T(25);                                                     //   Указываем опорную температуру жидкости. Обычно используют 20°С или 25°С. По умолчанию 25°С.
         }                                                                         //
     }                                                                             //
//   Выводим сообщение:                                                            //
     Serial.print((String) "Найдено "+sum+" TDS-метров, с адресами: " );           //
     for(uint8_t i=0; i<sum; i++){ Serial.print(arrID[i]); Serial.print(", "); }   //
     Serial.println();                                                             //
}                                                                                  //
                                                                                   //
void loop(){                                                                       //
     for(uint8_t i=0; i<sum; i++){                                                 //   Проходим по всем TDS-метрам.
         sensor[i].set_t(25.0);                                                    //   Указываем модулю температуру жидкости в которую погружен щуп.
         Serial.print( "Модуль с адресом ");                                       //
         Serial.print( sensor[i].getID()  );                                       //
         Serial.print( " показывает TDS " );                                       //
         Serial.print( sensor[i].getTDS() );                                       //
         Serial.print( " ppm. \r\n"       );                                       //
         delay(1000);                                                              //
     }                                                                             //
}                                                                                  //
